## conf/distro/econ-tiny.conf
```bitbake
include conf/distro/include/econ-tiny.inc
include conf/distro/include/spec.inc
include conf/distro/include/optimization.inc
  
DISTRO_FEATURES = "acl ipv4 ipv6 largefile xattr virtualization"
DISTRO_FEATURES:remove = "pulseaudio gobject-introspection-data ldconfig"
  
TCLIBC = "musl"
  
VIRTUAL-RUNTIME_dev_manager ?= "" 
VIRTUAL-RUNTIME_login_manager ?= "" 
VIRTUAL-RUNTIME_init_manager = "busybox"
VIRTUAL-RUNTIME_initscripts ?= "" 
VIRTUAL-RUNTIME_keymaps ?= "" 

require conf/machine/default.conf 
```

## conf/distro/econ.conf
```bitbake
include conf/distro/include/econ.inc
include conf/distro/include/spec.inc

DISTRO_FEATURES = "acl ipv4 ipv6 largefile xattr virtualization"
DISTRO_FEATURES:remove = "pulseaudio gobject-introspection-data ldconfig"

INIT_MANAGER="systemd"

VIRTUAL-RUNTIME_dev_manager ?= ""
VIRTUAL-RUNTIME_login_manager ?= ""
VIRTUAL-RUNTIME_init_manager = "systemd"
VIRTUAL-RUNTIME_initscripts ?= ""
VIRTUAL-RUNTIME_keymaps ?= ""

require conf/machine/default.conf
```

## conf/distro/include/econ-tiny.inc
```bitbake
DISTRO = "econ-tiny"
DISTRO_NAME = "e-Con Tiny Linux"
DISTRO_VERSION = "econ-tiny-linux-${DATE}"
DISTRO_CODENAME = "moon"
  
SDK_VENDOR = "-econtsdk"
SDK_VERSION="econ-tiny-linux-${DATE}"
  
MAINTAINER = "Emre Eryilmaz <emre.eryilmaz@piesso.com>"
  
TARGET_VENDOR = "-econt"

DISTROOVERRIDES = "econ-tiny"

hostname:pn-base-files = "econ-tiny"
```

## conf/distro/include/econ.inc
```bitbake
DISTRO = "econ"
DISTRO_NAME = "e-Con Linux"
DISTRO_VERSION = "econ-linux-${DATE}"
DISTRO_CODENAME = "earth"
  
SDK_VENDOR = "-econsdk"
SDK_VERSION="econ-linux-${DATE}"
  
MAINTAINER = "Emre Eryilmaz <emre.eryilmaz@piesso.com>"
  
TARGET_VENDOR = "-econ"

DISTROOVERRIDES = "econ"

hostname:pn-base-files = "econ"
```

## conf/distro/include/optimization.inc
```bitbake
# Disabled until the option works properly -feliminate-dwarf2-dups
FULL_OPTIMIZATION = "-Os -pipe ${DEBUG_FLAGS}"
```

## conf/distro/include/spec.inc
```bitbake
VOLATILE_LOG_DIR = "no"
  
INHERIT += "extrausers"
EXTRA_USERS_PARAMS = "usermod -P root root;"
  
FORCE_RO_REMOVE = "1"
NO_RECOMMENDATIONS = "1"
```

## conf/layer.conf
```bitbake
# We have a conf and classes directory, add to BBPATH
BBPATH .= ":${LAYERDIR}"

# We have recipes-* directories, add to BBFILES
BBFILES += "${LAYERDIR}/recipes-*/*/*.bb \
            ${LAYERDIR}/recipes-*/*/*.bbappend"

BBFILE_COLLECTIONS += "meta-container"
BBFILE_PATTERN_meta-container = "^${LAYERDIR}/"
BBFILE_PRIORITY_meta-container = "6"


# This should only be incremented on significant changes that will
# cause compatibility issues with other layers
LAYERVERSION_meta-container = "1"
LAYERSERIES_COMPAT_meta-container = "hardknott"
LAYERDEPENDS_meta-container = "core"
```

## conf/machine/default.conf
```bitbake
MACHINE_FEATURES=""
MACHINE_FEATURES_remove ="rtc qemu-usermode"
MACHINE_ESSENTIAL_EXTRA_RDEPENDS = ""
MACHINE_ESSENTIAL_EXTRA_RRECOMMENDS = ""
MACHINE_EXTRA_RRECOMMENDS = ""

PREFERRED_PROVIDER_virtual/kernel = "linux-dummy"

IMAGE_FSTYPES = "tar.xz"
```
